// The web app and the JSON interface it works on (web_api.h).
#include "web_api.h"

#include <esp_ota_ops.h>       // the app partition's size, for the system section
#include <esp_image_format.h>  // and the program's (programSize())
#include "webui_page.h"        // the web app, gzipped, and FW_VERSION; generated by scripts/embed_webui.py
#include "band_items.h"
#include "brightness.h"
#include "clock_state.h"
#include "clock_time.h"
#include "console.h"
#include "feeds.h"
#include "gif_player.h"
#include "home_assistant.h"
#include "hotspot.h"
#include "info_band.h"
#include "input.h"
#include "lan_access.h"
#include "notices.h"
#include "panel_rules.h"
#include "sensors.h"
#include "settings.h"
#include "time_sync.h"
#include "time_zones.h"
#include "web_server.h"
#include "wifi_station.h"

// The firmware's version for the modules (clock_state.h): only this file
// includes the generated header, so a new version rebuilds it alone.
const char *fwVersion() { return FW_VERSION; }

// What only this module calls, ahead of its use.
static void applyParams(const String &q);
static String applyWifiForm(const String &body);
static void printAgo(Print &c, unsigned long at);
static FaceOutcome applyLiveParams(const String &q);
static String applyKeysForm(const String &q);
static void sendPreviewOutcome(Print &c, FaceOutcome o);
static String homeWifiStatusText();
static uint32_t programSize();
static const char *resetReasonText();
static const char *timeSourceText();
static void apiStatusInto(JsonDocument &d);
static void apiState(Print &c);
static void apiGestures(Print &c);
static void apiPanel(Print &c);
static size_t packRead(WiFiClient &client, uint8_t *buf, size_t want);
static void packDrain(WiFiClient &client, long left);
static void drawPackProgress(uint32_t done, uint32_t total);
static void apiSetTime(Print &c, const String &q);
static void apiSave(Print &c, const String &body, bool &closeHotspot);

// The web app's settings to be saved: the clock's, the faces' and the
// Inputs page's profile and mount with the sync days, each as its table has
// it (settings_table.h), and the two with code of their own, the zone and
// the sides the classic face's digits come from.
static void applyParams(const String &q) {
  auto get = [&q](const char *key) { return getParam(q, key); };
  String v = getParam(q, "tz");
  if (v.length()) { settings.tzOffset = (int32_t)v.toInt(); }   // seconds, from the dropdown
  if (settingsApply(clockTable, get, false) & PARAM_REDRAW) { panelDirty = true; }   // a colour sent
  applyFaceParams(q, false, false);   // the faces' own settings (face.h)
  for (int i = 0; i < 6; i++) {
    v = getParam(q, "dir" + String(i));
    if (v.length()) { settings.classic.dir[i] = constrain(v.toInt(), 0, 3); }
  }
  settingsApply(uiTable, get, false);
}

// The home WiFi form (/wifi, POST). Returns what is wrong with it, or "" once
// the credentials in RAM have been replaced. A password left empty keeps the
// stored one.
static String applyWifiForm(const String &body) {
  String ssid = getParam(body, "ssid");
  String pw   = getParam(body, "pw");
  if (ssid.length() == 0 || ssid.length() > 32) { return "The network name must be 1 to 32 characters long."; }
  if (pw.length() != 0 && (pw.length() < 8 || pw.length() > 63)) { return "The password must be 8 to 63 characters long."; }
  // The same network and password again keep what the clock knows about them.
  bool same = strcmp(wifiCreds.ssid, ssid.c_str()) == 0 && (pw.length() == 0 || strcmp(wifiCreds.pass, pw.c_str()) == 0);
  memset(wifiCreds.ssid, 0, sizeof(wifiCreds.ssid));
  strncpy(wifiCreds.ssid, ssid.c_str(), sizeof(wifiCreds.ssid) - 1);
  if (pw.length()) {
    memset(wifiCreds.pass, 0, sizeof(wifiCreds.pass));
    strncpy(wifiCreds.pass, pw.c_str(), sizeof(wifiCreds.pass) - 1);
  }
  if (!same) {
    wifiCreds.verified = 0;          // a new config until a sync has worked over it
    joinOutcome = JOIN_NOT_TRIED;   // whatever happened, happened with the network before
  }
  Console.print("WiFi: stored "); Console.println(wifiCreds.ssid);
  return "";
}



// "just now", "12 min ago" or "3 h ago", for a millis() stamp.
static void printAgo(Print &c, unsigned long at) {
  unsigned long minutes = (millisNow - at) / 60000UL;
  if (minutes == 0)        { c.print("just now"); }
  else if (minutes < 120)  { c.print(minutes); c.print(" min ago"); }
  else                     { c.print(minutes / 60); c.print(" h ago"); }
}

// Live preview (/live): apply only the visual settings to RAM, no flash write,
// no reboot. The clock is being rendered every frame, so changes show instantly.
// Returns what became of a preview the page asked for (OUTCOME_NONE: none).
static FaceOutcome applyLiveParams(const String &q) {
  uint8_t faceBefore = settings.watchface;
  // The clock's settings tried live (PARAM_LIVE in CLOCK_PARAMS): the
  // watchface, the brightness and its sensor's mapping - updateBrightness()
  // re-seeds the fade - and the classic face's fly-in and colours.
  if (settingsApply(clockTable, [&q](const char *key) { return getParam(q, key); }, true) & PARAM_REDRAW) {
    panelDirty = true;   // a colour sent
  }
  // The faces' own settings, and what the page asks to see - but a face just
  // chosen shows itself as it comes (the Tetris digits drop, the others show
  // the time) and plays no preview with it: it has planned nothing yet.
  return applyFaceParams(q, true, settings.watchface == faceBefore);
}







// /keys: the Inputs page sent. Nothing is taken unless an input found still
// opens the menu; the error says why.
static String applyKeysForm(const String &q) {
  uint8_t codes[FACE_EVENT_COUNT];
  memcpy(codes, faceKeys, sizeof(codes));
  for (uint8_t i = 0; i < FACE_EVENT_COUNT; i++) {
    String v = getParam(q, String("k") + i);
    if (v.length()) {
      long a = v.toInt();
      codes[i] = (a >= 0 && faceActionOffered((uint8_t)a, FACE_EVENTS[i].event)) ? (uint8_t)a : 0;
    }
  }
  if (!faceKeysReachMenu(codes)) {
    return "None of the inputs found would open the menu, so nothing was saved. "
           "Give one of them \"open the menu\".";
  }
  memcpy(faceKeys, codes, sizeof(codes));   // the page's profile and mount follow with the rest (UI_PARAMS)
  faceKeysOwn = true;
  return String();
}

/* ----------------------------------------------------------------------
   The web app (S3): one page, webui/index.html, which the build gzips into
   webui_page.h (scripts/embed_webui.py), and the JSON interface it works on.
   It reads with GET /api/state (everything once), /api/status (what moves)
   and /api/panel (the canvas as it is drawn), and writes with the same
   parameters the old page sent, through the same handlers: applyLiveParams(),
   applyParams(), applyKeysForm(), applyGifParams(), applyFeedParams(),
   applyWifiForm().
   ---------------------------------------------------------------------- */

// Collects what a Print-based helper writes, for a JSON string.
class StringPrint : public Print {
 public:
  String text;
  size_t write(uint8_t b) override { text += (char)b; return 1; }
};

void sendWebApp(Print &c) {
  c.println("HTTP/1.1 200 OK");
  c.println("Content-Type: text/html; charset=utf-8");
  c.println("Content-Encoding: gzip");
  c.print("Content-Length: "); c.println(WEBUI_GZ_LEN);
  c.println("Cache-Control: no-cache");
  c.println("Connection: close");
  c.println();
  c.write(WEBUI_GZ, WEBUI_GZ_LEN);
}


// The answer to a change tried live: nothing when it asked for no preview,
// else whether the face played it now or could not (it does not wait).
static void sendPreviewOutcome(Print &c, FaceOutcome o) {
  if (o == OUTCOME_NONE) { sendNoContent(c); return; }
  JsonDocument d;
  d["preview"] = o == OUTCOME_PLAYED ? "played" : "refused";
  sendJson(c, d);
}


// The home WiFi as the clock last found it, as plain text (printHomeWifiStatus()
// writes the same for the old page, with its markup).
static String homeWifiStatusText() {
  if (!wifiStored()) { return "No home WiFi stored: the clock gets no time from the internet."; }
  StringPrint t;
  t.print(wifiCreds.ssid);
  switch (joinOutcome) {
    case JOIN_SUCCEEDED:
      t.print(": last joined "); printAgo(t, joinOutcomeAt);
      t.print(", signal "); t.print(joinRssi); t.print(" dBm");
      break;
    case JOIN_FAILED:
      t.print(": could not join "); printAgo(t, joinOutcomeAt);
      t.print(" ("); t.print(joinFailText(joinFailStatus)); t.print(")");
      break;
    default:
      t.print(": not joined since the clock started");
      break;
  }
  t.print(wifiCreds.verified ? ". A known-good config." : ". A new config: no sync has worked over it yet.");
  return t.text;
}

// The running program's size in flash, from its image's headers; 0 when they
// cannot be read. ESP.getSketchSize() gives the same, but verifies the whole
// image for it, its SHA-256 over 1.5 MB: 121-138 ms on the S3 (2026-10-22),
// in one step of the web server, so /api/state held the loop that long
// (0.4 ms now).
static uint32_t programSize() {
  const esp_partition_t *app = esp_ota_get_running_partition();
  if (!app) { return 0; }
  esp_partition_pos_t pos = { app->address, app->size };
  esp_image_metadata_t image = {};
  return esp_image_get_metadata(&pos, &image) == ESP_OK ? image.image_len : 0;
}

static const char *resetReasonText() {
  switch (esp_reset_reason()) {
    case ESP_RST_POWERON:   return "power-on";
    case ESP_RST_SW:        return "restart by the firmware";
    case ESP_RST_PANIC:     return "a crash";
    case ESP_RST_INT_WDT:
    case ESP_RST_TASK_WDT:
    case ESP_RST_WDT:       return "a watchdog";
    case ESP_RST_BROWNOUT:  return "a brownout (supply too weak)";
    case ESP_RST_DEEPSLEEP: return "deep sleep";
    case ESP_RST_EXT:       return "the reset button";
    case ESP_RST_USB:       return "USB";
    default:                return "unknown";
  }
}

static const char *timeSourceText() {
  switch (timeSource) {
    case TIME_NTP:    return "NTP";
    case TIME_PHONE:  return "phone";
    case TIME_MANUAL: return "by hand";
    case TIME_RTC:    return "RTC";
    default:          return "none";
  }
}

// What moves: the panel's brightness and light, the time, the screen, and the
// info band's sources and items. Polled by the page.
static void apiStatusInto(JsonDocument &d) {
  d["bright"] = effectiveBrightness;
  if (lastLux >= 0) { d["lux"] = serialized(String(lastLux, 1)); } else { d["lux"] = nullptr; }
#if BOARD_WAVESHARE_WALL
  if (roomValid) {   // the room's, filtered and corrected; absent without the sensor
    d["temp"] = serialized(String(roomTempNow(), 1));
    d["hum"] = lroundf(roomHumNow());
    d["tempSensor"] = serialized(String(roomTemp, 1));   // as the sensor reads, for its warmth
    d["humSensor"] = lroundf(roomHum);
  }
#endif
  d["clockSet"] = clockIsSet();
  if (clockIsSet()) {
    time_t local = clockNow() + tzTotalOffset();
    char hm[8];
    snprintf(hm, sizeof(hm), "%02d:%02d", clockHour(local), clockMinute(local));
    d["clock"] = hm;
  }
  d["src"] = timeSourceText();
  d["timeLine"] = timeStatusText();
  d["rot"] = matrix.getRotation();
  d["screen"] = (uint8_t)screen;
  d["gif"] = (screen == SCREEN_GIF);
  JsonArray feeds = d["feeds"].to<JsonArray>();
  for (uint8_t f = 0; f < FEED_COUNT; f++) {
    const FeedRun &r = feedRuns[f];
    JsonObject o = feeds.add<JsonObject>();
    o["on"] = feedOn(f);
    o["always"] = FEEDS[f].needsAlways;   // needs continuous network access
    // Why it does not fetch, if it does not: the page says so.
    if (!feedSettings.located)                       { o["blocked"] = "place"; }
    else if (!wifiStored())                          { o["blocked"] = "wifi"; }
    else if (FEEDS[f].needsAlways && !lanIsOn())     { o["blocked"] = "always"; }
    else if (!clockIsSet())                          { o["blocked"] = "time"; }
    o["failures"] = r.failures;
    if (r.error[0]) { o["error"] = r.error; }
    if (r.okAt) {
      char when[16];
      bandWhen(when, sizeof(when), r.okAt);
      o["okAt"] = when;
      o["ms"] = r.ms;
      if (r.bytes >= 0) { o["bytes"] = r.bytes; }
    }
  }
  d["place"] = feedPlace;
  // The minute of the next info round, in the clock's time; empty while it is off.
  char roundAt[16] = "";
  if (feedSettings.roundMinutes && clockIsSet()) {
    unsigned long in = roundMinuteAt ? 0 : roundNextIn();
    bandWhen(roundAt, sizeof(roundAt), clockNow() + (time_t)((in + 999UL) / 1000UL));
  }
  d["round"] = roundAt;
  JsonArray items = d["items"].to<JsonArray>();
  for (uint8_t i = 0; i < bandItemCount; i++) {
    JsonObject o = items.add<JsonObject>();
    char until[16];
    bandWhen(until, sizeof(until), bandItems[i].until);
    o["key"] = bandItems[i].key;
    o["text"] = bandItems[i].text;
    o["icon"] = bandItems[i].icon;
    o["alert"] = bandItems[i].level == LEVEL_ALERT;
    o["until"] = until;
    o["shows"] = itemShowsHere(bandItems[i]);
    o["ha"] = bandItems[i].feed == SOURCE_HA;
  }
  haStatusInto(d["haStatus"].to<JsonObject>());
}


// Everything once: the settings as they are now (with live changes not saved
// yet), the lists to choose from, what the clock found, and its state.
static void apiState(Print &c) {
  JsonDocument d;
  d["mode"] = apActive ? "ap" : "lan";
  d["fw"] = FW_VERSION;
  d["board"] = BOARD_NAME;
  JsonArray panel = d["panel"].to<JsonArray>();
  panel.add(BOARD_PANEL_W);
  panel.add(BOARD_PANEL_H);

  JsonObject s = d["settings"].to<JsonObject>();
  for (uint8_t i = 0; i < SETTINGS_TABLE_COUNT; i++) { settingsJson(*SETTINGS_TABLES[i], s); }   // each as its table has it: wf .. toff
  s["tz"] = settings.tzOffset;
  JsonArray dirs = s["dirs"].to<JsonArray>();
  for (uint8_t i = 0; i < 6; i++) { dirs.add(settings.classic.dir[i]); }
  JsonArray keys = s["keys"].to<JsonArray>();
  for (uint8_t i = 0; i < FACE_EVENT_COUNT; i++) { keys.add(faceKeys[i]); }
  JsonArray closes = s["closes"].to<JsonArray>();   // per face event: whether it closes a notice
  for (uint8_t i = 0; i < FACE_EVENT_COUNT; i++) { closes.add(noticeCloses[i] != 0); }
  char deg[16];
  feedDegrees(deg, sizeof(deg), feedSettings.lat);
  s["lat"] = feedSettings.located ? deg : "";
  feedDegrees(deg, sizeof(deg), feedSettings.lon);
  s["lon"] = feedSettings.located ? deg : "";
#if BAND_ON_PANEL
  d["band"] = true;       // the information takes turns in the band: no info round
#else
  s["iround"] = feedSettings.roundMinutes;
#endif
  s["ssid"] = wifiCreds.ssid;

  JsonObject lanJ = d["lan"].to<JsonObject>();
  lanJ["on"] = lanIsOn();
  lanJ["hasPassword"] = lanHasPassword();
  lanJ["defaultPassword"] = lanPasswordIs(AP_PASS);
  lanJ["host"] = netHostname();
  if (stationUp()) { lanJ["ip"] = WiFi.localIP().toString(); }
  haSettingsInto(d["ha"].to<JsonObject>());

  JsonObject lists = d["lists"].to<JsonObject>();
  JsonArray tz = lists["tz"].to<JsonArray>();
  for (unsigned int i = 0; i < sizeof(TZONES) / sizeof(TZONES[0]); i++) {
    JsonArray o = tz.add<JsonArray>();
    o.add(TZONES[i].off);
    o.add(TZONES[i].label);
  }
  JsonArray profiles = lists["profiles"].to<JsonArray>();
  JsonArray profileKeys = lists["profileKeys"].to<JsonArray>();
  for (uint8_t p = 0; p < INPUT_PROFILE_COUNT; p++) {
    profiles.add(INPUT_PROFILES[p].name);
    uint8_t codes[FACE_EVENT_COUNT];
    faceKeysOfProfile(p, codes);
    JsonArray k = profileKeys.add<JsonArray>();
    for (uint8_t i = 0; i < FACE_EVENT_COUNT; i++) { k.add(codes[i]); }
  }
  JsonArray actions = lists["actions"].to<JsonArray>();
  for (uint8_t a = 0; a < FACE_ACTION_COUNT; a++) { actions.add(FACE_ACTIONS[a].label); }
  for (uint8_t a = 0; a < FACE_ACTION_COUNT; a++) {
    if (FACE_ACTIONS[a].function == FN_OPEN_MENU) { lists["menuAction"] = a; }   // what has to stay reachable
  }
  JsonArray events = lists["events"].to<JsonArray>();
  for (uint8_t i = 0; i < FACE_EVENT_COUNT; i++) {
    const FaceEvent &e = FACE_EVENTS[i];
    JsonObject o = events.add<JsonObject>();
    o["label"] = e.label;
    o["fitted"] = faceEventFitted(e.event);
    o["menu"] = faceEventCountsForMenu(e.event);   // counts for "some input opens the menu"
    JsonArray offered = o["actions"].to<JsonArray>();
    for (uint8_t a = 0; a < FACE_ACTION_COUNT; a++) {
      if (faceActionOffered(a, e.event)) { offered.add(a); }
    }
  }
  for (uint8_t i = 0; i < SETTINGS_TABLE_COUNT; i++) {   // the choices by value, with names in their tables: shs, mst .. anap
    settingsLists(*SETTINGS_TABLES[i], [&lists](const char *key, const char *const *labels, uint8_t n) {
      JsonArray a = lists[key].to<JsonArray>();
      for (uint8_t k = 0; k < n; k++) { a.add(labels[k]); }
    });
  }
  JsonArray dxr = lists["dxr"].to<JsonArray>();   // by value: the extras' slider, DECOR_EXTRAS_MINUTES
  for (uint8_t i = 0; i <= DECOR_EXTRAS_MAX; i++) {
    uint8_t m = DECOR_EXTRAS_MINUTES[i];
    dxr.add(m ? String("about every ") + m + " min" : String("never"));
  }
#if !BAND_ON_PANEL
  JsonArray rounds = lists["iround"].to<JsonArray>();   // the info round's choices, in minutes (0 = never)
  for (uint8_t m : ROUND_CHOICES) { rounds.add(m); }
#endif
  // What the web app needs to send each setting back: per key its kind, its
  // range as stored, and whether it is tried live (settings_table.h). Not
  // the days between syncs without a real-time clock to keep the time
  // meanwhile, nor the gesture sensor's mount without the sensor: the page
  // does not offer them then.
  JsonObject form = lists["form"].to<JsonObject>();
  for (uint8_t i = 0; i < SETTINGS_TABLE_COUNT; i++) {
    settingsForm(*SETTINGS_TABLES[i], [&form](const char *key, const char *kind, uint16_t lo, uint16_t hi, bool live) {
      if ((!rtcSync && !strcmp(key, "syncd")) || (!gestureOK && !strcmp(key, "gmount"))) { return; }
      JsonArray a = form[key].to<JsonArray>();
      a.add(kind);
      a.add(lo);
      a.add(hi);
      a.add(live);
    });
  }

  JsonObject hw = d["hw"].to<JsonObject>();
  hw["tetris"] = true;    // every board has every face (the web app still asks)
  hw["muncher"] = true;
  hw["aliens"] = true;
  hw["accel"] = accelOK;
  hw["knock"] = knockOK;   // as the knock's row on the Inputs page
  hw["buttons"] = BOARD_BUTTON_COUNT;
#if BOARD_WAVESHARE_WALL
  hw["knockBy"] = "QMI8658";
#endif
  hw["gesture"] = gestureOK;
  hw["gestureInt"] = GESTURE_INT >= 0;
  hw["rtc"] = rtcOK;
  hw["rtcLost"] = rtcLostPower;
  hw["rtcSync"] = rtcSync;           // the NTP sync waits for its interval (syncDays)
  hw["rtcChip"] = rtcChipName();     // the one whose time counts
  JsonArray i2c = hw["i2c"].to<JsonArray>();   // the addresses that answered at boot
  for (uint8_t a = 0; a < 128; a++) {
    if (i2cFound[a / 8] & (1 << (a % 8))) {
      char hex[8];
      snprintf(hex, sizeof(hex), "0x%02X", a);
      i2c.add(hex);
    }
  }
#if BOARD_WAVESHARE_WALL
  JsonArray i2cBoard = hw["i2cBoard"].to<JsonArray>();   // the same on the board's own bus
  for (uint8_t a = 0; a < 128; a++) {
    if (i2cBoardFound[a / 8] & (1 << (a % 8))) {
      char hex[8];
      snprintf(hex, sizeof(hex), "0x%02X", a);
      i2cBoard.add(hex);
    }
  }
#endif
  hw["lux"] = lastLux >= 0;
  // Every sensor this board supports (sensors.h): found at this start and on
  // which try, found at an earlier start, missing now.
  hw["sensorTries"] = SENSOR_TRIES;
  JsonArray sensors = hw["sensors"].to<JsonArray>();
  for (uint8_t i = 0; i < SENSOR_COUNT; i++) {
    if (!(sensorsSupported() & (1 << i))) { continue; }
    const SensorKind &k = SENSOR_KINDS[i];
    JsonObject o = sensors.add<JsonObject>();
    o["id"] = k.key;
    o["chip"] = k.chip;
    o["what"] = k.what;
    char hex[8];
    snprintf(hex, sizeof(hex), "0x%02X", k.addr);
    o["addr"] = hex;
    o["bus"] = k.boardBus ? "board" : "main";
    o["tries"] = sensorTries[i];                     // 0: not found at this start
    o["seen"] = (sensorsSeen & (1 << i)) != 0;       // found at an earlier start, not forgotten
    o["missing"] = (sensorsMissing & (1 << i)) != 0;
  }

  JsonObject gifs = d["gifs"].to<JsonObject>();
  gifs["pack"] = (gifPackState == GIF_PACK_OK) ? gifPackCount : 0;
  gifs["packState"] = gifPackState == GIF_PACK_OK ? "ok" : gifPackState == GIF_PACK_BAD ? "damaged" : "none";
  gifs["packMaxKb"] = gifPackPart ? gifPackPart->size / 1024 : 0;   // what POST /api/pack takes
#if BOARD_WAVESHARE_WALL
  gifs["source"] = gifFromCard ? "card" : "pack";
  JsonObject sd = gifs["card"].to<JsonObject>();
  sd["mounted"] = cardMounted;
  uint16_t sdBad = 0;
  for (uint16_t i = 0; i < cardList.count; i++) { if (cardList.gifs[i].bad) { sdBad++; } }
  sd["gifs"] = cardList.count - sdBad;
  sd["leftOut"] = sdBad;
  sd["mb"] = cardMb;
  sd["freeMb"] = cardFreeMb;
  sd["reading"] = cardRemountWanted || (cardJobBusy && !cardMounted);
#endif

  JsonObject wifi = d["wifi"].to<JsonObject>();
  wifi["stored"] = wifiStored();
  wifi["line"] = homeWifiStatusText();
  wifi["scanFailed"] = scanFailed;
  JsonArray nets = wifi["networks"].to<JsonArray>();
  for (uint8_t i = 0; i < seenCount; i++) {
    JsonArray n = nets.add<JsonArray>();
    n.add(seenNetworks[i].ssid);
    n.add(seenNetworks[i].rssi);
    n.add(seenNetworks[i].open);
  }

  JsonObject sys = d["system"].to<JsonObject>();
  sys["uptime"] = millis() / 1000UL;
  sys["heapFree"] = heap_caps_get_free_size(MALLOC_CAP_INTERNAL);
  sys["heapLow"] = heap_caps_get_minimum_free_size(MALLOC_CAP_INTERNAL);
  sys["psramFree"] = ESP.getFreePsram();
  sys["program"] = programSize();
  const esp_partition_t *app = esp_ota_get_running_partition();
  sys["programMax"] = app ? app->size : 0;
  sys["reset"] = resetReasonText();
  sys["bootStage"] = prevBootStage;
  sys["mac"] = WiFi.macAddress();   // the board's, as esptool prints it: a tool checks it before it writes

  apiStatusInto(d);   // and what moves, so the page starts complete
  sendJson(c, d);
}

// The gesture sensor for the gesture test: whether the test is up, the
// sensor's turn and the panel's rotation, what is in view, and the last
// gestures, newest first - the sensor's own direction, the event the panel
// made of it, and whether it was taken.
static void apiGestures(Print &c) {
  JsonDocument d;
  d["found"] = gestureOK;
  d["test"] = screen == SCREEN_GESTURE_TEST;
  d["count"] = gestureTestCount;
  d["mount"] = uiSettings.gestureMount;
  d["rotation"] = screenRotation;
  d["tuned"] = gestureTuned;
  d["waves"] = gestureWaves;
  if (screen == SCREEN_GESTURE_TEST && gestureNearBright >= 0) {
    d["near"]["brightness"] = gestureNearBright;
    d["near"]["size"] = gestureNearSize;
  }
  JsonArray events = d["events"].to<JsonArray>();
  for (uint8_t i = 0; i < gestureSeenCount; i++) {
    const GestureSeen &g = gestureSeen[i];
    int8_t name = faceEventIndex((InputEvent)g.ev);
    JsonObject o = events.add<JsonObject>();
    o["ago"] = millisNow - g.at;
    o["sensor"] = gestureRawName(g.raw);
    o["panel"] = name >= 0 ? FACE_EVENTS[name].label : "?";
    o["taken"] = g.taken;
    char bits[8];
    snprintf(bits, sizeof(bits), "%02X %02X", g.r43, g.r44);   // the registers 0x43 and 0x44 as read (the test only)
    o["bits"] = bits;
  }
  sendJson(c, d);
}

// The canvas as it is drawn (RGB565, row by row in the panel's own
// orientation; the page turns it by "rot" from /api/status). A GIF is drawn
// past the canvas, straight into the panel driver, so it does not show here.
static void apiPanel(Print &c) {
  const size_t bytes = (size_t)64 * 32 * 2;
  c.println("HTTP/1.1 200 OK");
  c.println("Content-Type: application/octet-stream");
  c.print("Content-Length: "); c.println(bytes);
  c.println("Cache-Control: no-store");
  c.println("Connection: close");
  c.println();
  c.write((const uint8_t *)matrix.getBuffer(), bytes);
}

// POST /api/pack: a GIF pack (the layout scripts/gif_pack.py writes), sent
// whole as the request body, into the ffat partition. Its header is checked
// before anything is erased, so a file that is no pack leaves the old one as
// it was. The header is written last, so an upload that breaks off leaves no
// pack rather than a damaged one. The loop
// waits for it - a full partition takes about half a minute - and the panel
// shows how far it is.
const uint32_t PACK_ERASE_BLOCK = 65536;            // erased ahead of the data, a flash block at a time
const unsigned long PACK_READ_TIMEOUT_MS = 5000;    // the longest gap in the upload before it counts as broken off

void apiPackUpload(WiFiClient &client, Print &out, long length) {
  if (!gifPackPart) {
    gifPackPart = esp_partition_find_first(ESP_PARTITION_TYPE_DATA, ESP_PARTITION_SUBTYPE_DATA_FAT, "ffat");
  }
  if (!gifPackPart) {
    packDrain(client, length);
    sendJsonError(out, 500, "This clock has no partition for a GIF pack.");
    return;
  }
  if (length < (long)sizeof(GifPackHeader) || (uint32_t)length > gifPackPart->size) {
    packDrain(client, length);
    String e = "Not a GIF pack this clock holds: it takes up to " + String(gifPackPart->size / 1024) + " KB.";
    sendJsonError(out, 400, e.c_str());
    return;
  }
  unsigned long started = millis();
  GifPackHeader h;
  if (packRead(client, (uint8_t *)&h, sizeof(h)) != sizeof(h)) {
    sendJsonError(out, 400, "The upload broke off before the pack's header; the old pack stays.");
    return;
  }
  uint32_t indexBytes = (uint32_t)h.count * sizeof(GifPackEntry);
  if (memcmp(h.magic, "CLKGPACK", sizeof(h.magic)) != 0 || h.version != 1 || h.count == 0
      || h.count > GIF_PACK_COUNT_MAX || h.size != (uint32_t)length || sizeof(h) + indexBytes > h.size) {
    packDrain(client, length - (long)sizeof(h));
    sendJsonError(out, 400, "Not a GIF pack this clock reads (scripts/gif_pack.py writes them); the old pack stays.");
    return;
  }

  // Nothing plays from the old pack while it is overwritten.
  if (screen == SCREEN_GIF) { closeScreen(); }
  gifPackState = GIF_PACK_NONE;
  free(gifPack);
  gifPack = nullptr;
  gifPackCount = 0;
#if BOARD_WAVESHARE_WALL
  if (!gifFromCard)   // the card's GIFs stay as they are
#endif
  gifLast = -1;   // it may have been a pack GIF the new pack does not have
  Console.printf("GIF pack: receiving %u GIFs, %u KB\n", h.count, (unsigned)(h.size / 1024));

  uint8_t *buf = (uint8_t *)malloc(4096);
  uint32_t at = sizeof(h), erasedTo = 0, shownAt = 0;
  bool ok = buf != nullptr;
  drawPackProgress(0, h.size);
  while (ok && at < h.size) {
    size_t n = packRead(client, buf, min(h.size - at, (uint32_t)4096));
    if (n == 0) { ok = false; break; }
    // Erase ahead of the data, a block at a time; the first block takes the
    // old header with it.
    while (ok && erasedTo < at + n) {
      uint32_t len = min(PACK_ERASE_BLOCK, (uint32_t)gifPackPart->size - erasedTo);
      ok = esp_partition_erase_range(gifPackPart, erasedTo, len) == ESP_OK;
      erasedTo += len;
    }
    if (!ok || esp_partition_write(gifPackPart, at, buf, n) != ESP_OK) { ok = false; break; }
    at += n;
    if (at - shownAt >= PACK_ERASE_BLOCK || at == h.size) { drawPackProgress(at, h.size); shownAt = at; }
    delay(1);   // the rest of the loop is waiting; let the idle task in
  }
  free(buf);
  if (ok) { ok = esp_partition_write(gifPackPart, 0, &h, sizeof(h)) == ESP_OK; }
  gifPackLoad();        // what the partition holds now: the new pack, the old one, or none
  panelDirty = true;    // the progress is still on the panel
  if (!ok) {
    String e = "The upload broke off after " + String(at / 1024) + " of " + String(h.size / 1024) + " KB; ";
    e += (erasedTo == 0) ? "the old pack stays." : "the clock has no GIF pack now and plays no GIFs.";
    Console.println("GIF pack: " + e);
    sendJsonError(out, 400, e.c_str());
    return;
  }
  if (gifPackState != GIF_PACK_OK) {
    sendJsonError(out, 400, "The pack arrived, but its index is damaged; the clock plays no GIFs.");
    return;
  }
  // Every GIF's bytes against its CRC, as each is checked again before it plays.
  uint16_t damaged = 0;
  for (uint16_t n = 0; n < gifPackCount; n++) {
    if (!gifPackCrcOk(gifPack[n])) { damaged++; }
  }
  gifScheduleNext();
  unsigned long ms = millis() - started;
  Console.printf("GIF pack: written, %u GIFs, %u damaged, %lu ms\n", gifPackCount, damaged, ms);
  JsonDocument d;
  d["ok"] = damaged == 0;
  d["gifs"] = gifPackCount;
  d["damaged"] = damaged;
  d["kb"] = h.size / 1024;
  d["ms"] = ms;
  sendJson(out, d);
}

// Up to want bytes of the request body: what arrives with no gap longer than
// PACK_READ_TIMEOUT_MS; fewer when the client stops sending.
static size_t packRead(WiFiClient &client, uint8_t *buf, size_t want) {
  size_t got = 0;
  unsigned long last = millis();
  while (got < want) {
    int n = client.read(buf + got, want - got);
    if (n > 0) {
      got += n;
      last = millis();
      continue;
    }
    if (!client.connected() && client.available() == 0) { break; }
    if (millis() - last > PACK_READ_TIMEOUT_MS) { break; }
    delay(1);
  }
  return got;
}

// Reads and drops the rest of a body that is refused, so the client gets the
// answer: closing the socket with data unread resets the connection, and the
// answer goes with it (seen with a file that was no pack).
static void packDrain(WiFiClient &client, long left) {
  uint8_t buf[512];
  while (left > 0) {
    size_t n = packRead(client, buf, (size_t)min(left, (long)sizeof(buf)));
    if (n == 0) { return; }
    left -= (long)n;
  }
}

// The panel while a GIF pack is written: what happens, and how far it is.
static void drawPackProgress(uint32_t done, uint32_t total) {
  uint8_t percent = total ? (uint8_t)((uint64_t)done * 100 / total) : 0;
  int16_t w = matrix.width(), h = matrix.height();
  uint16_t ink = scaledColorVisible(255, 140, 0);
  matrix.fillScreen(0);
  matrix.setFont(&fontPicopixel);
  matrix.setTextColor(ink);
  matrix.setCursor(1, 7);
  matrix.print("GIF PACK");
  matrix.drawRect(1, h / 2 - 3, w - 2, 7, ink);
  matrix.fillRect(2, h / 2 - 2, (int16_t)((int32_t)(w - 4) * percent / 100), 5, ink);
  matrix.setCursor(1, h - 2);
  matrix.print(percent);
  matrix.print(" %");
  matrix.show();
}

// The clock's time from a phone (utc=) or typed in (date= and time=, the
// clock's local time). Answers with the new status line.
static void apiSetTime(Print &c, const String &q) {
  String utc = getParam(q, "utc");
  if (utc.length()) {
    int64_t t = strtoll(utc.c_str(), nullptr, 10);
    if (t < UTC_PLAUSIBLE_FROM || t > UTC_PLAUSIBLE_TO) { sendJsonError(c, 400, "Not set: the phone's time looks wrong."); return; }
    setClockTo((time_t)t, TIME_PHONE);
    Console.print("Time set from a phone: "); Console.println((unsigned long)t);
  } else {
    String date = getParam(q, "date"), hm = getParam(q, "time");
    int y = date.substring(0, 4).toInt(), mo = date.substring(5, 7).toInt(), dd = date.substring(8, 10).toInt();
    int h = hm.substring(0, 2).toInt(), mi = hm.substring(3, 5).toInt();
    if (date.length() != 10 || hm.length() < 5 || y < 2024 || y > 2099 || mo < 1 || mo > 12 ||
        dd < 1 || dd > 31 || h < 0 || h > 23 || mi < 0 || mi > 59) {
      sendJsonError(c, 400, "Not set: enter both a date and a time.");
      return;
    }
    time_t local = (time_t)daysFromCivil(y, mo, dd) * 86400 + h * 3600 + mi * 60;
    setClockTo(localToUtc(local), TIME_MANUAL);
    Console.println("Time set by hand");
  }
  JsonDocument d;
  d["timeLine"] = timeStatusText();
  sendJson(c, d);
}

// Save: every setting the page sends, checked first where a check can refuse
// (the face shortcuts must leave a way into the menu), so a refused save
// changes nothing. Saved is said only when every part is in the flash; a
// part that could not be written there works until the next restart, and
// the page says so - the hotspot stays open for it.
static void apiSave(Print &c, const String &body, bool &closeHotspot) {
  String error = applyKeysForm(body);
  if (error.length()) { sendJsonError(c, 400, error.c_str()); return; }
  applyParams(body);
  applySettings();            // the runtime copies: animation speed, sync time
  setDstMode(settings.dst);   // a new zone's daylight-saving rule counts at once
  bool stored = saveSettings();
  stored &= saveFaceSettings();
  stored &= saveUiSettings();
  stored &= saveFaceKeys();
  applyNoticeKeysForm(body);
  stored &= saveNoticeKeys();
  if (!ntpSyncOn() && syncState != SYNC_IDLE) { setSyncState(SYNC_IDLE); }
  applyGifParams(body);
  stored &= saveGifSettings();
  gifScheduleNext();          // the new times count from now
  applyDecorParams(body);
  stored &= saveDecorSettings();
  applyFeedParams(body);
  stored &= saveFeedSettings();
#if BOARD_WAVESHARE_WALL
  stored &= applySensorParams(body);
#endif
  if (!stored) {
    Console.println("Settings from the web app: NOT all stored, the flash could not be written");
    sendJsonError(c, 500, "Not saved in full: the clock could not write its flash. The settings work now; "
                          "after a restart some may be as before.");
    return;
  }
  Console.println("Settings saved from the web app");
  JsonDocument d;
  d["ok"] = true;
  d["closing"] = apActive;    // in the hotspot, saving closes it, as it always has
  sendJson(c, d);
  closeHotspot = apActive;
}

void webApi(Print &c, const String &path, bool isPost, const String &body,
            bool &closeHotspot, bool &syncNow, bool &restart) {
  if (path == "/api/state") { apiState(c); return; }
  if (path == "/api/status") {
    JsonDocument d;
    apiStatusInto(d);
    sendJson(c, d);
    return;
  }
  if (path == "/api/panel") { apiPanel(c); return; }
  if (path == "/api/gestures") { apiGestures(c); return; }
  if (!isPost) { sendJsonError(c, 404, "Unknown request."); return; }
  if (path == "/api/gesturetest") {
    // on=1 starts the gesture test over the face, on=0 ends it; tune=1 or 0
    // alone switches the sensor's wave settings.
    String tune = getParam(body, "tune");
    if (tune.length() && gestureOK) { gestureTune(tune == "1"); }
    String on = getParam(body, "on");
    if (on == "1") { gestureTestStart(); } else if (on == "0") { gestureTestStop(); }
    apiGestures(c);
    return;
  }
  if (path == "/api/live") {
    // RAM only; Save keeps it, Discard reads the stored settings back.
    sendPreviewOutcome(c, applyLiveParams(body));
  } else if (path == "/api/save") {
    apiSave(c, body, closeHotspot);
  } else if (path == "/api/sensor-forget") {
    // id=<sensor>: one this clock no longer has is no longer missing.
    if (sensorForget(getParam(body, "id"))) { sendNoContent(c); } else { sendJsonError(c, 400, "No such sensor."); }
#if BOARD_WAVESHARE_WALL
  } else if (path == "/api/black") {
    // The wall's panels dark until the next start: before a flash (the
    // console's "black", in every build).
    matrix.holdDark();
    Console.println("Panels dark until the next start");
    sendNoContent(c);
#endif
  } else if (path == "/api/discard") {
    loadSettings();           // the stored settings, with the faces' ones, applied at once
    // The face shows what was restored, as after a change tried live (U1 of
    // the face refactor: until 2026-10-20 only the Tetris face did).
    sendPreviewOutcome(c, faceFor(settings.watchface).request(faceMoment(), TRIGGER_PREVIEW_CHANGE));
  } else if (path == "/api/time") {
    apiSetTime(c, body);
  } else if (path == "/api/wifi") {
    String error = applyWifiForm(body);
    if (error.length()) { sendJsonError(c, 400, error.c_str()); return; }
    if (!saveWifiCreds()) {
      // The hotspot stays open, so this can be seen.
      sendJsonError(c, 500, "Not saved: the clock could not write its flash. It knows this WiFi until the next restart.");
      return;
    }
    JsonDocument d;
    d["ok"] = true;
    d["closing"] = apActive;
    sendJson(c, d);
    if (apActive) { closeHotspot = true; syncNow = true; }   // join it and fetch the time at once
  } else if (path == "/api/forget") {
    if (!forgetWifi()) {
      sendJsonError(c, 500, "The clock could not write its flash: it forgets this WiFi only until the next restart.");
      return;
    }
    JsonDocument d;
    d["line"] = homeWifiStatusText();
    sendJson(c, d);
  } else if (path == "/api/gif") {
    bool onFace = (screen == SCREEN_FACE);
    // Over the face, now or not at all, also during or into the time's change
    // (gifPlayNow()). Whether it played says why not: on the face, with GIFs
    // to play, it could not be opened this moment (the card's next one not
    // read yet, no RAM for the decoder).
    if (onFace) { gifPlayNow(); }
    bool playing = onFace && screen == SCREEN_GIF;
    JsonDocument d;
    d["playing"] = playing;
    d["busy"] = onFace && !playing && gifCount() > 0;
    sendJson(c, d);
#if BOARD_WAVESHARE_WALL
  } else if (path == "/api/card") {
    // The card read anew - a card put in, or GIFs changed on it - as soon
    // as no GIF plays; the pack plays meanwhile.
    cardRemountWanted = true;
    JsonDocument d;
    d["reading"] = true;
    sendJson(c, d);
#endif
  } else if (path == "/api/messages") {
    // The notices once more, as FN_SHOW_MESSAGES shows them; a GIF on show
    // ends for them.
    if (screen == SCREEN_GIF) { closeScreen(); }
    JsonDocument d;
    d["onFace"] = screen == SCREEN_FACE;
    d["shown"] = noticesShowAgain();
    sendJson(c, d);
  } else if (path == "/api/lan") {
    apiLan(c, body);
  } else if (path == "/api/ha") {
    apiHa(c, body);
#if defined(CLOCK_DEBUG) || defined(FACE_FRAME_LOG)
  } else if (path == "/api/test") {
    apiTest(c, body);
#endif
  } else if (path == "/api/restart") {
    sendNoContent(c);
    restart = true;
  } else {
    sendJsonError(c, 404, "Unknown request.");
  }
}
