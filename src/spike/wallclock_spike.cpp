/* ----------------------------------------------------------------------
   Wall clock hardware spike - not part of the clock firmware.

   For the Waveshare ESP32-S3-RGB-Matrix with 64x64 P3 panels at 1/32 scan
   (UI concept, section "Wall clock hardware"). It answers what the clock
   firmware needs to know before it supports the board, with the panel driver
   the clock runs on the MatrixPortal S3 (ESP32-HUB75-MatrixPanel-DMA):
     - which driver chip init, clock phase and bus clock the panels need,
     - how the chain is cabled (which panel sits where, turned how),
     - refresh rate, colour depth and frame buffer memory per layout
       (2x1 = 128x64, 3x2 = 192x128, 4x2 = 256x128),
     - how long a full frame takes to draw through the panel mapping,
     - whether WiFi works beside the running panel bus,
     - which I2C devices answer on the board bus and on the GPIO header.

   Builds: env:wallclock_spike (frame buffer in internal RAM) and
   env:wallclock_spike_psram (frame buffer in PSRAM, -D SPIRAM_DMA_BUFFER).

   Carried over from the clock on the MatrixPortal S3:
     - the HUB75 pins run at GPIO drive strength 0: at the driver's 3 the
       nonstop bus kept WiFi from working (20 of 30 TCP connects failed);
     - clock phase 0 is the default (the MatrixPortal panel needs it, with 1
       the picture sits one column to the left);
     - NO_CIE1931: brightness and colours stay linear, as in the clock;
     - GIFs: decoded as in the clock, gamma 2.2, drawn centred and unscaled.

   Panel: the BOOT button steps through the screens (short press) and the
   brightness (held). Screens:
     1 Chain   each panel of the chain as the driver sees it: its number in
               the chain, an arrow to its own top, its left column red and its
               right column green. Shows the cabling, how each panel is turned
               and the clock phase (a missing red or a doubled green column).
     2 Layout  the whole wall through the panel mapping: frame, diagonal,
               circle, an arrow up. Continuous and upright when the mapping
               fits the cabling.
     3 Ramps   red, green, blue and white from 0 to 255, and white 0..32.
     4 Motion  stripes moving across the whole wall, every pixel drawn each
               frame: tearing, smoothness, and the time a full frame takes.
     5 GIFs    the built-in GIFs that fit, one after the other.
     6 Info    the settings and measurements.

   USB console (115200): "help" lists the commands. Settings live in NVS
   (namespace "wcspike") and the driver's take effect after a restart, which
   the command does itself. Three starts in a row that do not get past the
   panel start bring the defaults back.
   ------------------------------------------------------------------------- */
#include <Arduino.h>
#include <Wire.h>
#include <WiFi.h>
#include <Preferences.h>
#include <esp_heap_caps.h>
#include <esp_system.h>
#include <driver/gpio.h>
#include <soc/lcd_cam_struct.h>
#include <new>
#include <ESP32-HUB75-MatrixPanel-I2S-DMA.h>
#include <AnimatedGIF.h>
#include "gif_library.h"          // generated by scripts/embed_gifs.py
#if __has_include("arduino_secrets.h")
  #include "arduino_secrets.h"    // SECRET_SSID / SECRET_PASS for the WiFi test
#endif

// Board pins: Waveshare's example code (esp32s3-default-pins.hpp) and BSP
// (config.h), checked against the schematic.
const int8_t PIN_R1 = 4,  PIN_G1 = 5,  PIN_B1 = 6;
const int8_t PIN_R2 = 7,  PIN_G2 = 15, PIN_B2 = 16;
const int8_t PIN_A  = 18, PIN_B  = 8,  PIN_C  = 3, PIN_D = 42, PIN_E = 9;
const int8_t PIN_LAT = 40, PIN_OE = 2, PIN_CLK = 41;
const int8_t HUB75_PINS[] = { PIN_R1, PIN_G1, PIN_B1, PIN_R2, PIN_G2, PIN_B2,
                              PIN_A, PIN_B, PIN_C, PIN_D, PIN_E, PIN_LAT, PIN_OE, PIN_CLK };
const int8_t PIN_SDA_BOARD = 47, PIN_SCL_BOARD = 48;   // onboard sensors, behind a level shifter
const int8_t PIN_SDA_EXT   = 45, PIN_SCL_EXT   = 46;   // GPIO header: DS3231, PAJ7620U2, BH1750
const int8_t PIN_BOOT      = 0;

const int16_t PANEL = 64;              // pixels per panel edge
const uint8_t MAX_PANELS = 8;          // 4x2 = 256x128, the largest wall clock in the plan
const uint8_t MAX_SIDE = 4;

// Router probe of the WiFi test: TCP connects to the gateway's web interface.
const uint16_t PROBE_PORT = 80;
const uint8_t  PROBE_COUNT = 30;
const uint16_t PROBE_TIMEOUT_MS = 2000;

const unsigned long HOLD_MS = 600;           // BOOT held this long: next brightness
const unsigned long GIF_SHOW_MS = 10000;     // each GIF this long
const unsigned long STABLE_MS = 10000;       // running this long counts as a good start
const uint8_t BRIGHT_STEPS[] = { 4, 8, 16, 32, 64, 128 };

// --- Settings -------------------------------------------------------------------
const uint8_t SETTINGS_VERSION = 1;
struct Settings {
  uint8_t version;
  uint8_t cols, rows;      // panels across and down
  uint8_t depth;           // bit planes per colour
  uint8_t clkMHz;          // bus clock asked of the driver: 8, 16 or 20
  uint8_t minRate;         // refresh (Hz) the driver keeps up by shortening the low bit planes
  uint8_t clkPhase;        // 0: data on the falling clock edge
  uint8_t chip;            // HUB75_I2S_CFG::shift_driver: init sequence of the panel's driver chip
  uint8_t doubleBuf;
  uint8_t latBlank;        // latch blanking in clocks
  uint8_t drive;           // GPIO drive strength of the HUB75 pins, 0..3
  uint8_t brightness;      // 0..255, through the OE time
  uint8_t rotation;        // the whole picture, quarter turns
  uint8_t panelCol[MAX_PANELS], panelRow[MAX_PANELS], panelRot[MAX_PANELS];   // per chain panel
};
Settings s;
Preferences prefs;

const char *CHIP_NAMES[] = { "shift", "fm6124", "fm6126a", "icn2038s", "mbi5124", "dp3246" };
const uint8_t CHIP_COUNT = sizeof(CHIP_NAMES) / sizeof(CHIP_NAMES[0]);

uint8_t panelCount() { return s.cols * s.rows; }

// Chain panel 1 in the given corner, the chain running along the rows; snake:
// every second row runs back with its panels turned over (180 degrees).
void chainPreset(bool fromRight, bool fromBottom, bool snake) {
  for (uint8_t k = 0; k < panelCount(); k++) {
    uint8_t r = k / s.cols, i = k % s.cols;
    bool back = snake && (r & 1);
    uint8_t c = back ? s.cols - 1 - i : i;
    s.panelCol[k] = fromRight ? s.cols - 1 - c : c;
    s.panelRow[k] = fromBottom ? s.rows - 1 - r : r;
    s.panelRot[k] = back ? 2 : 0;
  }
}

// Defaults: wall clock A (2x1). The Waveshare example inits FM6126A chips;
// that sequence leaves plain shift-register chips as they are.
void settingsDefaults() {
  s = Settings();
  s.version = SETTINGS_VERSION;
  s.cols = 2; s.rows = 1;
  s.depth = 8; s.clkMHz = 8; s.minRate = 120;
  s.clkPhase = 0;
  s.chip = HUB75_I2S_CFG::FM6126A;
  s.doubleBuf = 1;
  s.latBlank = 2;
  s.drive = 0;
  s.brightness = 32;
  s.rotation = 0;
  chainPreset(false, false, false);
}

bool settingsValid() {
  if (s.version != SETTINGS_VERSION) { return false; }
  if (s.cols < 1 || s.rows < 1 || s.cols > MAX_SIDE || s.rows > MAX_SIDE || panelCount() > MAX_PANELS) { return false; }
  if (s.depth < 2 || s.depth > 8) { return false; }
  if (s.clkMHz != 8 && s.clkMHz != 16 && s.clkMHz != 20) { return false; }
  if (s.minRate < 30 || s.clkPhase > 1 || s.chip >= CHIP_COUNT || s.doubleBuf > 1) { return false; }
  if (s.latBlank > 4 || s.drive > 3 || s.rotation > 3) { return false; }
  for (uint8_t k = 0; k < panelCount(); k++) {
    if (s.panelCol[k] >= s.cols || s.panelRow[k] >= s.rows || s.panelRot[k] > 3) { return false; }
  }
  return true;
}

void settingsLoad() {
  if (prefs.getBytes("cfg", &s, sizeof(s)) != sizeof(s) || !settingsValid()) { settingsDefaults(); }
}

void settingsSave() { prefs.putBytes("cfg", &s, sizeof(s)); }

// --- Panel ----------------------------------------------------------------------
MatrixPanel_I2S_DMA *dma = nullptr;
bool panelOk = false;
float busMHz = 0;                       // what the S3 makes of the asked clock, read back from LCD_CAM
int8_t cell[MAX_SIDE][MAX_SIDE];        // chain panel at each wall position, -1 for none
unsigned long flippedAt = 0;            // micros() of the last buffer flip

volatile uint32_t frameEdges = 0;       // rising edges on address line E: one per refresh
uint32_t measuredHz = 0;

void IRAM_ATTR onFrameEdge(void *) { frameEdges = frameEdges + 1; }

void setDrive(uint8_t d) {
  for (int8_t p : HUB75_PINS) { gpio_set_drive_capability((gpio_num_t)p, (gpio_drive_cap_t)d); }
}

void buildCells() {
  for (auto &row : cell) { for (auto &c : row) { c = -1; } }
  for (uint8_t k = 0; k < panelCount(); k++) { cell[s.panelRow[k]][s.panelCol[k]] = k; }
  for (uint8_t r = 0; r < s.rows; r++) {
    for (uint8_t c = 0; c < s.cols; c++) {
      if (cell[r][c] < 0) { Serial.printf("Placement: no chain panel at col %u, row %u\n", c, r); }
    }
  }
}

// Bytes of one frame buffer: the driver keeps every bit plane of every row
// pair, one 16-bit word per pixel of the chain.
size_t frameBufferBytes() { return (size_t)(PANEL / 2) * PANEL * panelCount() * s.depth * 2; }

uint32_t refreshPeriodUs() {
  uint32_t hz = measuredHz ? measuredHz : (dma ? dma->calculated_refresh_rate : 0);
  return hz ? 1000000UL / hz : 20000;
}

bool panelStart() {
  HUB75_I2S_CFG::i2s_pins pins = { PIN_R1, PIN_G1, PIN_B1, PIN_R2, PIN_G2, PIN_B2,
                                   PIN_A, PIN_B, PIN_C, PIN_D, PIN_E, PIN_LAT, PIN_OE, PIN_CLK };
  HUB75_I2S_CFG cfg(PANEL, PANEL, panelCount(), pins);
  cfg.driver = (HUB75_I2S_CFG::shift_driver)s.chip;
  cfg.double_buff = s.doubleBuf;
  cfg.i2sspeed = s.clkMHz == 20 ? HUB75_I2S_CFG::HZ_20M : s.clkMHz == 16 ? HUB75_I2S_CFG::HZ_16M : HUB75_I2S_CFG::HZ_8M;
  cfg.latch_blanking = s.latBlank;
  cfg.clkphase = s.clkPhase;
  cfg.min_refresh_rate = s.minRate;
  cfg.setPixelColorDepthBits(s.depth);

  Serial.printf("Panel: %ux%u panels = %ux%u, %u bit, clock %u MHz asked, phase %u, chip %s, %s buffer, blanking %u\n",
                s.cols, s.rows, s.cols * PANEL, s.rows * PANEL, s.depth, s.clkMHz, s.clkPhase,
                CHIP_NAMES[s.chip], s.doubleBuf ? "double" : "single", s.latBlank);
#if defined(SPIRAM_DMA_BUFFER)
  const char *where = "PSRAM";
#else
  const char *where = "internal RAM";
#endif
  Serial.printf("Frame buffer: %u KB x %u in %s; internal RAM free %u KB (largest block %u KB), PSRAM free %u KB\n",
                (unsigned)(frameBufferBytes() / 1024), s.doubleBuf ? 2 : 1, where,
                (unsigned)(heap_caps_get_free_size(MALLOC_CAP_INTERNAL) / 1024),
                (unsigned)(heap_caps_get_largest_free_block(MALLOC_CAP_INTERNAL) / 1024),
                (unsigned)(heap_caps_get_free_size(MALLOC_CAP_SPIRAM) / 1024));

  dma = new MatrixPanel_I2S_DMA(cfg);
  if (!dma->begin()) {
    Serial.println("Panel: the driver did not start (memory? see its log above). Change the settings and restart.");
    return false;
  }
  setDrive(s.drive);
  dma->setBrightness8(s.brightness);
  busMHz = 160.0f / LCD_CAM.lcd_clock.lcd_clkm_div_num;   // the LCD peripheral runs off 160 MHz
  Serial.printf("Panel: running, bus %.1f MHz, driver's refresh estimate %d Hz (it reckons with the asked clock)\n",
                busMHz, dma->calculated_refresh_rate);
  Serial.printf("After the start: internal RAM free %u KB, PSRAM free %u KB\n",
                (unsigned)(heap_caps_get_free_size(MALLOC_CAP_INTERNAL) / 1024),
                (unsigned)(heap_caps_get_free_size(MALLOC_CAP_SPIRAM) / 1024));

  // The refresh as it happens: E is the top row-address bit, it rises once
  // per pass over the 32 row pairs. Its input buffer is switched on beside the
  // output, which the LCD peripheral keeps driving.
  gpio_input_enable((gpio_num_t)PIN_E);
  gpio_set_intr_type((gpio_num_t)PIN_E, GPIO_INTR_POSEDGE);
  gpio_install_isr_service(0);
  gpio_isr_handler_add((gpio_num_t)PIN_E, onFrameEdge, nullptr);
  return true;
}

// Before drawing into the back buffer: the frame on show before the last
// flip may still be going out (the S3 flips without waiting for the frame end).
void beginFrame() {
  if (!s.doubleBuf) { return; }
  uint32_t period = refreshPeriodUs() + 500;
  while (micros() - flippedAt < period) { delayMicroseconds(100); }
}

void present() {
  if (!s.doubleBuf) { return; }
  dma->flipDMABuffer();
  flippedAt = micros();
}

// A restart with dark panels: without the driver the panels keep showing the
// row last latched at full duty.
void restartBlank() {
  prefs.putUChar("boots", 0);
  if (panelOk) {
    for (int i = 0; i < 2; i++) { beginFrame(); dma->clearScreen(); present(); }
    dma->setBrightness8(0);
    delayMicroseconds(refreshPeriodUs() * 2);
  }
  Serial.println("Restarting.");
  Serial.flush();
  esp_restart();
}

// The wall as one picture: wall pixels (after the turn of the whole picture)
// go through the panel placement onto the chain the driver drives.
class Wall : public Adafruit_GFX {
public:
  Wall(int16_t w, int16_t h) : Adafruit_GFX(w, h) {}

  void drawPixel(int16_t x, int16_t y, uint16_t c) override {
    uint8_t r = (c >> 8) & 0xF8, g = (c >> 3) & 0xFC, b = (c << 3) & 0xF8;
    rgb(x, y, r | (r >> 5), g | (g >> 6), b | (b >> 5));
  }

  void rgb(int16_t x, int16_t y, uint8_t r, uint8_t g, uint8_t b) {
    if (toChain(x, y)) { dma->drawPixelRGB888(x, y, r, g, b); }
  }

  bool toChain(int16_t &x, int16_t &y) const {
    if (x < 0 || y < 0 || x >= _width || y >= _height) { return false; }
    int16_t t;
    switch (rotation) {                       // as GFXcanvas16::drawPixel
      case 1: t = x; x = WIDTH - 1 - y; y = t; break;
      case 2: x = WIDTH - 1 - x; y = HEIGHT - 1 - y; break;
      case 3: t = x; x = y; y = HEIGHT - 1 - t; break;
    }
    int8_t k = cell[y / PANEL][x / PANEL];
    if (k < 0) { return false; }
    int16_t lx = x % PANEL, ly = y % PANEL, px, py;
    switch (s.panelRot[k]) {                  // the panel turned clockwise, in quarter turns
      case 1:  px = ly;             py = PANEL - 1 - lx; break;
      case 2:  px = PANEL - 1 - lx; py = PANEL - 1 - ly; break;
      case 3:  px = PANEL - 1 - ly; py = lx;             break;
      default: px = lx;             py = ly;             break;
    }
    x = k * PANEL + px;
    y = py;
    return true;
  }
};
Wall *wall = nullptr;

uint16_t c565(uint8_t r, uint8_t g, uint8_t b) { return ((r & 0xF8) << 8) | ((g & 0xFC) << 3) | (b >> 3); }

// --- I2C ------------------------------------------------------------------------
TwoWire wireExt(1);
uint8_t devicesBoard = 0, devicesExt = 0;

// Name of a device at an I2C address, from the parts this clock may carry.
const char *i2cName(uint8_t addr) {
  switch (addr) {
    case 0x18: return "ES8311 codec";
    case 0x23: return "BH1750 light";
    case 0x40: return "ES7210 ADC";
    case 0x51: return "PCF85063 RTC";
    case 0x57: return "DS3231 module EEPROM";
    case 0x68: return "DS3231 RTC";
    case 0x6A:
    case 0x6B: return "QMI8658 IMU";
    case 0x70: return "SHTC3";
    case 0x73: return "PAJ7620U2 gesture";
    default:   return "?";
  }
}

uint8_t scanBus(TwoWire &bus, const char *label) {
  Serial.printf("I2C %s:", label);
  uint8_t found = 0;
  for (uint8_t addr = 0x08; addr < 0x78; addr++) {
    bus.beginTransmission(addr);
    if (bus.endTransmission() == 0) {
      Serial.printf(" 0x%02X %s;", addr, i2cName(addr));
      found++;
    }
  }
  Serial.println(found ? "" : " nothing");
  return found;
}

// QMI8658 WHO_AM_I (register 0x00) reads 0x05, as Waveshare's sensor test checks.
void checkQmi() {
  for (uint8_t addr : { 0x6B, 0x6A }) {
    Wire.beginTransmission(addr);
    Wire.write(0x00);
    if (Wire.endTransmission(false) != 0) { continue; }
    if (Wire.requestFrom((int)addr, 1) == 1) {
      uint8_t who = Wire.read();
      Serial.printf("QMI8658 at 0x%02X: WHO_AM_I 0x%02X (%s)\n", addr, who, who == 0x05 ? "ok" : "unexpected");
      return;
    }
  }
  Serial.println("QMI8658: no answer");
}

void scanI2c() {
  devicesBoard = scanBus(Wire, "board (47/48)");
  devicesExt = scanBus(wireExt, "header (45/46)");
  checkQmi();
}

// --- WiFi test ------------------------------------------------------------------
// Runs once after "wifi" and a restart: the router probe before the panel
// starts, then with the panel running at each drive strength.
struct Probe { uint8_t ok; uint32_t sumMs, maxMs; };

Probe probeRouter() {
  Probe p = { 0, 0, 0 };
  IPAddress gw = WiFi.gatewayIP();
  for (uint8_t i = 0; i < PROBE_COUNT; i++) {
    WiFiClient c;
    uint32_t t0 = millis();
    bool ok = c.connect(gw, PROBE_PORT, PROBE_TIMEOUT_MS);
    uint32_t dt = millis() - t0;
    c.stop();
    if (ok) { p.ok++; p.sumMs += dt; p.maxMs = max(p.maxMs, dt); }
    delay(50);
  }
  return p;
}

void printProbe(const char *label, const Probe &p) {
  Serial.printf("  %-26s %2u/%u connects, avg %4lu ms, max %4lu ms\n", label, p.ok, PROBE_COUNT,
                (unsigned long)(p.ok ? p.sumMs / p.ok : 0), (unsigned long)p.maxMs);
}

bool wifiJoin() {
#if defined(SECRET_SSID) && defined(SECRET_PASS)
  WiFi.mode(WIFI_STA);
  WiFi.begin(SECRET_SSID, SECRET_PASS);
  for (int i = 0; i < 200 && WiFi.status() != WL_CONNECTED; i++) { delay(100); }
  if (WiFi.status() != WL_CONNECTED) { Serial.println("WiFi test: could not join"); return false; }
  Serial.printf("WiFi test: joined, RSSI %d dBm, channel %d, gateway %s\n",
                WiFi.RSSI(), WiFi.channel(), WiFi.gatewayIP().toString().c_str());
  return true;
#else
  Serial.println("WiFi test: no src/arduino_secrets.h with SECRET_SSID and SECRET_PASS");
  return false;
#endif
}

void wifiOff() {
  WiFi.disconnect(true);
  WiFi.mode(WIFI_OFF);
}

// --- Screens --------------------------------------------------------------------
enum Screen : uint8_t { SCR_CHAIN, SCR_LAYOUT, SCR_RAMPS, SCR_MOTION, SCR_GIF, SCR_INFO, SCR_COUNT };
const char *SCREEN_NAMES[] = { "chain", "layout", "ramps", "motion", "gifs", "info" };
uint8_t screen = SCR_CHAIN;
unsigned long screenDrawnAt = 0;

const uint8_t PANEL_COLOURS[MAX_PANELS][3] = {
  { 255, 255, 255 }, { 255, 200, 0 }, { 0, 200, 255 }, { 255, 0, 255 },
  { 120, 255, 0 }, { 255, 120, 0 }, { 0, 120, 255 }, { 200, 120, 255 } };

// In the driver's own coordinates, panel k at x = 64k: what is drawn upright
// here stands upright on a panel that is not turned.
void drawChain() {
  dma->clearScreen();
  for (uint8_t k = 0; k < panelCount(); k++) {
    int16_t x0 = k * PANEL;
    const uint8_t *c = PANEL_COLOURS[k];
    uint16_t colour = dma->color565(c[0], c[1], c[2]);
    dma->drawFastHLine(x0, 0, PANEL, dma->color565(60, 60, 60));
    dma->drawFastHLine(x0, PANEL - 1, PANEL, dma->color565(60, 60, 60));
    dma->drawFastVLine(x0, 0, PANEL, dma->color565(255, 0, 0));
    dma->drawFastVLine(x0 + PANEL - 1, 0, PANEL, dma->color565(0, 255, 0));
    dma->fillTriangle(x0 + 32, 4, x0 + 25, 13, x0 + 39, 13, colour);
    dma->setTextSize(4);
    dma->setTextColor(colour);
    dma->setCursor(x0 + 21, 20);
    dma->print(k + 1);
  }
}

void drawLayout() {
  dma->clearScreen();
  int16_t w = wall->width(), h = wall->height();
  uint16_t white = c565(160, 160, 160);
  wall->drawRect(0, 0, w, h, white);
  wall->drawLine(0, 0, w - 1, h - 1, c565(255, 0, 0));
  wall->drawLine(w - 1, 0, 0, h - 1, c565(0, 0, 255));
  wall->drawCircle(w / 2, h / 2, min(w, h) / 2 - 3, c565(0, 255, 0));
  wall->fillTriangle(w / 2, 3, w / 2 - 6, 12, w / 2 + 6, 12, c565(255, 200, 0));
  wall->setTextSize(1);
  wall->setTextColor(c565(255, 200, 0));
  char text[16];
  snprintf(text, sizeof(text), "%dx%d", w, h);
  wall->setCursor(w / 2 - (int16_t)strlen(text) * 3, h / 2 - 4);
  wall->print(text);
}

void drawRamps() {
  dma->clearScreen();
  int16_t w = wall->width(), h = wall->height(), band = h / 5;
  for (int16_t x = 0; x < w; x++) {
    uint8_t v = x * 255 / (w - 1), dark = x * 32 / (w - 1);
    for (int16_t y = 0; y < band; y++) {
      wall->rgb(x, y, v, 0, 0);
      wall->rgb(x, y + band, 0, v, 0);
      wall->rgb(x, y + 2 * band, 0, 0, v);
      wall->rgb(x, y + 3 * band, v, v, v);
    }
    for (int16_t y = 4 * band; y < h; y++) { wall->rgb(x, y, dark, dark, dark); }
  }
}

void drawInfo() {
  dma->clearScreen();
  wall->setTextSize(1);
  wall->setTextWrap(false);
  wall->setTextColor(c565(200, 200, 200));
  wall->setCursor(1, 1);
  wall->printf("%dx%d %ux%u\n", wall->width(), wall->height(), s.cols, s.rows);
  wall->printf("%ubit %.1fMHz ph%u\n", s.depth, busMHz, s.clkPhase);
  wall->printf("%s %s bl%u\n", CHIP_NAMES[s.chip], s.doubleBuf ? "dbl" : "sgl", s.latBlank);
  wall->printf("refresh %luHz\n", (unsigned long)measuredHz);
  wall->printf("driver says %d\n", dma->calculated_refresh_rate);
  wall->printf("RAM %uK PS %uK\n", (unsigned)(heap_caps_get_free_size(MALLOC_CAP_INTERNAL) / 1024),
               (unsigned)(heap_caps_get_free_size(MALLOC_CAP_SPIRAM) / 1024));
  wall->printf("I2C %u + %u\n", devicesBoard, devicesExt);
  wall->printf("bright %u drive %u\n", s.brightness, s.drive);
}

// Motion: every pixel of the wall drawn each frame, as a full redraw of the
// clock would. Its time goes to the console every 2 s.
uint16_t motionStep = 0;
uint32_t motionUs = 0, motionFrames = 0;
unsigned long motionReportAt = 0;

void drawMotion() {
  int16_t w = wall->width(), h = wall->height();
  beginFrame();
  uint32_t t0 = micros();
  for (int16_t y = 0; y < h; y++) {
    for (int16_t x = 0; x < w; x++) {
      bool on = ((x + motionStep) / 8) & 1;
      wall->rgb(x, y, 0, on ? 40 : 0, on ? 160 : 0);
    }
  }
  motionUs += micros() - t0;
  motionFrames++;
  present();
  motionStep++;
  if (millis() - motionReportAt >= 2000) {
    Serial.printf("Motion: full frame %lu us for %d px (%lu ns per pixel)\n",
                  (unsigned long)(motionUs / motionFrames), w * h,
                  (unsigned long)((uint64_t)motionUs * 1000 / motionFrames / (w * h)));
    motionUs = motionFrames = 0;
    motionReportAt = millis();
  }
}

// GIFs, decoded as in the clock: RAW lines into an RGB888 canvas of the GIF's
// size, transparency and disposal 2 by hand, gamma 2.2 on the way out.
AnimatedGIF *gif = nullptr;
uint8_t *gifCanvas = nullptr;
int16_t gifW = 0, gifH = 0, gifIndex = -1;
unsigned long gifStartedAt = 0, gifNextFrameAt = 0;
bool gifRestartDue = false;
uint8_t gifGamma[256];
struct GifArea { int16_t x, y, w, h; uint8_t disposal; bool valid; };
GifArea gifPrev;

bool gifFits(int16_t i) {
  const BuiltInGif &g = BUILT_IN_GIFS[i];
  return g.size && g.width <= wall->width() && g.height <= wall->height();
}

void gifDrawLine(GIFDRAW *d) {
  int16_t y = d->iY + d->y;
  if (y < 0 || y >= gifH) { return; }
  const uint8_t *pal = d->pPalette24;
  for (int16_t i = 0; i < d->iWidth; i++) {
    int16_t x = d->iX + i;
    if (x < 0 || x >= gifW) { continue; }
    uint8_t idx = d->pPixels[i];
    if (d->ucHasTransparency && idx == d->ucTransparent) { continue; }
    uint8_t *c = &gifCanvas[(y * gifW + x) * 3];
    c[0] = pal[idx * 3]; c[1] = pal[idx * 3 + 1]; c[2] = pal[idx * 3 + 2];
  }
  if (d->y == 0) {
    gifPrev = { (int16_t)d->iX, (int16_t)d->iY, (int16_t)d->iWidth, (int16_t)d->iHeight, d->ucDisposalMethod, true };
  }
}

void gifStop() {
  if (gif) { gif->close(); delete gif; gif = nullptr; }
  if (gifCanvas) { heap_caps_free(gifCanvas); gifCanvas = nullptr; }
}

// The next GIF after gifIndex that fits the wall; false when none does.
bool gifNext() {
  gifStop();
  for (uint16_t n = 0; n < BUILT_IN_GIF_COUNT; n++) {
    int16_t i = (gifIndex + 1 + n) % BUILT_IN_GIF_COUNT;
    if (!gifFits(i)) { continue; }
    const BuiltInGif &g = BUILT_IN_GIFS[i];
    gif = new (std::nothrow) AnimatedGIF;
    gifCanvas = (uint8_t *)heap_caps_calloc(g.width * g.height, 3, MALLOC_CAP_SPIRAM);
    if (!gifCanvas) { gifCanvas = (uint8_t *)heap_caps_calloc(g.width * g.height, 3, MALLOC_CAP_INTERNAL); }
    if (!gif || !gifCanvas) { Serial.println("GIF: no RAM"); gifStop(); return false; }
    gif->begin(GIF_PALETTE_RGB888);
    if (!gif->open((uint8_t *)g.data, g.size, gifDrawLine)) {
      Serial.printf("GIF %s: does not open (%d)\n", g.name, gif->getLastError());
      gifStop();
      continue;
    }
    gifIndex = i;
    gifW = g.width;
    gifH = g.height;
    gifPrev.valid = false;
    gifRestartDue = false;
    gifStartedAt = gifNextFrameAt = millis();
    Serial.printf("GIF %u/%u: %s (%ux%u)\n", i + 1, BUILT_IN_GIF_COUNT, g.name, g.width, g.height);
    return true;
  }
  return false;
}

void gifRender() {
  int16_t w = wall->width(), h = wall->height();
  int16_t x0 = (w - gifW) / 2, y0 = (h - gifH) / 2;
  beginFrame();
  for (int16_t y = 0; y < h; y++) {
    for (int16_t x = 0; x < w; x++) {
      uint8_t r = 0, g = 0, b = 0;
      int16_t gx = x - x0, gy = y - y0;
      if (gx >= 0 && gy >= 0 && gx < gifW && gy < gifH) {
        const uint8_t *c = &gifCanvas[(gy * gifW + gx) * 3];
        r = gifGamma[c[0]]; g = gifGamma[c[1]]; b = gifGamma[c[2]];
      }
      wall->rgb(x, y, r, g, b);
    }
  }
  present();
}

void drawGif() {
  if (!gif || millis() - gifStartedAt >= GIF_SHOW_MS) {
    if (!gifNext()) {
      if (screenDrawnAt == 0) {
        beginFrame();
        dma->clearScreen();
        wall->setCursor(1, 1);
        wall->setTextColor(c565(200, 200, 200));
        wall->print("no GIF fits");
        present();
        screenDrawnAt = millis();
      }
      return;
    }
  }
  if ((long)(millis() - gifNextFrameAt) < 0) { return; }
  if (gifRestartDue) {
    gif->reset();
    memset(gifCanvas, 0, gifW * gifH * 3);
    gifPrev.valid = false;
    gifRestartDue = false;
  } else if (gifPrev.valid && gifPrev.disposal == 2) {
    for (int16_t y = max<int16_t>(gifPrev.y, 0); y < gifPrev.y + gifPrev.h && y < gifH; y++) {
      for (int16_t x = max<int16_t>(gifPrev.x, 0); x < gifPrev.x + gifPrev.w && x < gifW; x++) {
        memset(&gifCanvas[(y * gifW + x) * 3], 0, 3);
      }
    }
  }
  int delayMs = 0;
  int more = gif->playFrame(false, &delayMs);   // 0: this was the last frame, it still gets shown
  if (more < 0) { Serial.printf("GIF decode error %d\n", gif->getLastError()); }
  if (more <= 0) { gifRestartDue = true; }
  if (delayMs < 20) { delayMs = 100; }         // what browsers make of 0 and 10 ms
  gifNextFrameAt = millis() + delayMs;
  gifRender();
}

// Static screens draw once (Info again every 2 s); Motion and GIFs every pass.
void drawScreen(bool fresh) {
  if (!panelOk) { return; }
  switch (screen) {
    case SCR_MOTION: drawMotion(); return;
    case SCR_GIF:    drawGif(); return;
    case SCR_INFO:   if (!fresh && millis() - screenDrawnAt < 2000) { return; } break;
    default:         if (!fresh) { return; } break;
  }
  beginFrame();
  switch (screen) {
    case SCR_CHAIN:  drawChain(); break;
    case SCR_LAYOUT: drawLayout(); break;
    case SCR_RAMPS:  drawRamps(); break;
    case SCR_INFO:   drawInfo(); break;
  }
  present();
  screenDrawnAt = millis();
}

void showScreen(uint8_t n) {
  if (screen == SCR_GIF && n != SCR_GIF) { gifStop(); gifIndex = -1; }
  screen = n % SCR_COUNT;
  prefs.putUChar("screen", screen);
  motionUs = motionFrames = 0;
  motionReportAt = millis();
  Serial.printf("Screen %u: %s\n", screen + 1, SCREEN_NAMES[screen]);
  screenDrawnAt = 0;
  drawScreen(true);
}

void setBrightness(uint8_t b) {
  s.brightness = b;
  settingsSave();
  if (panelOk) { dma->setBrightness8(b); }
  Serial.printf("Brightness %u\n", b);
}

// --- Status ---------------------------------------------------------------------
void printStatus() {
  Serial.printf("Layout %ux%u (%ux%u px), turned %u; chain panels (col,row,turn):",
                s.cols, s.rows, s.cols * PANEL, s.rows * PANEL, s.rotation);
  for (uint8_t k = 0; k < panelCount(); k++) {
    Serial.printf(" %u=(%u,%u,%u)", k + 1, s.panelCol[k], s.panelRow[k], s.panelRot[k]);
  }
  Serial.println();
  Serial.printf("Driver: %u bit, clock %u MHz asked / %.1f MHz on the bus, refresh at least %u Hz asked, "
                "phase %u, chip %s, %s buffer, blanking %u, drive %u, brightness %u\n",
                s.depth, s.clkMHz, busMHz, s.minRate, s.clkPhase, CHIP_NAMES[s.chip],
                s.doubleBuf ? "double" : "single", s.latBlank, s.drive, s.brightness);
  if (panelOk) {
    Serial.printf("Refresh: %lu Hz measured on line E, driver's estimate %d Hz\n",
                  (unsigned long)measuredHz, dma->calculated_refresh_rate);
  } else {
    Serial.println("Panel: not running");
  }
  Serial.printf("Memory: internal free %u KB (largest block %u KB), PSRAM free %u KB; frame buffer %u KB x %u\n",
                (unsigned)(heap_caps_get_free_size(MALLOC_CAP_INTERNAL) / 1024),
                (unsigned)(heap_caps_get_largest_free_block(MALLOC_CAP_INTERNAL) / 1024),
                (unsigned)(heap_caps_get_free_size(MALLOC_CAP_SPIRAM) / 1024),
                (unsigned)(frameBufferBytes() / 1024), s.doubleBuf ? 2 : 1);
  Serial.printf("GIFs built in: %u\n", BUILT_IN_GIF_COUNT);
}

const char *resetReasonName(esp_reset_reason_t r) {
  switch (r) {
    case ESP_RST_POWERON:  return "power on";
    case ESP_RST_SW:       return "software restart";
    case ESP_RST_PANIC:    return "crash";
    case ESP_RST_INT_WDT:  return "interrupt watchdog";
    case ESP_RST_TASK_WDT: return "task watchdog";
    case ESP_RST_WDT:      return "watchdog";
    case ESP_RST_BROWNOUT: return "BROWNOUT (supply voltage dropped)";
    case ESP_RST_USB:      return "USB";
    default:               return "other";
  }
}

// --- Console --------------------------------------------------------------------
void printHelp() {
  Serial.println(
    "Commands (driver settings restart the board):\n"
    "  show                         settings, refresh, memory\n"
    "  layout <cols>x<rows>         panels across and down, at most 8 (chain back to 'chain tl z')\n"
    "  chain <tl|tr|bl|br> <z|s>    chain panel 1 in that corner, along the rows; z: every row\n"
    "                               the same way, s: every second row back, its panels turned over\n"
    "  panel <n> <col> <row> <turn> chain panel n (from 1) at col,row (from 0), turned clockwise\n"
    "                               by <turn> quarter turns\n"
    "  rot <0..3>                   turn the whole picture (portrait)\n"
    "  depth <2..8>                 bit planes per colour\n"
    "  clk <8|16|20>                bus clock asked of the driver (MHz)\n"
    "  rate <30..255>               refresh the driver keeps up by shortening the low bit planes\n"
    "  phase <0|1>                  clock phase\n"
    "  chip <shift|fm6124|fm6126a|icn2038s|mbi5124|dp3246>  init of the panels' driver chip\n"
    "  double <0|1>                 double buffering\n"
    "  blank <0..4>                 latch blanking\n"
    "  drive <0..3>                 GPIO drive strength of the HUB75 pins\n"
    "  bright <0..255>              brightness\n"
    "  screen <1..6>                chain, layout, ramps, motion, gifs, info\n"
    "  wifi                         WiFi test after a restart (needs src/arduino_secrets.h)\n"
    "  i2c                          scan both I2C buses\n"
    "  defaults                     all settings back\n"
    "  restart");
}

// Applies a driver setting: saved, then a restart.
void setAndRestart(uint8_t &field, long value, long lo, long hi) {
  if (value < lo || value > hi) { Serial.printf("Out of range (%ld..%ld)\n", lo, hi); return; }
  field = (uint8_t)value;
  settingsSave();
  restartBlank();
}

// Applies a change of the panel placement at once.
void placementChanged() {
  buildCells();
  if (screen == SCR_GIF) { gifStop(); }      // the next GIF that fits the wall as it is now
  settingsSave();
  printStatus();
  drawScreen(true);
}

void runCommand(char *line) {
  char *cmd = strtok(line, " \t");
  if (!cmd) { return; }
  char *a1 = strtok(nullptr, " \t"), *a2 = strtok(nullptr, " \t"), *a3 = strtok(nullptr, " \t"),
       *a4 = strtok(nullptr, " \t");
  long v = a1 ? strtol(a1, nullptr, 10) : -1;

  if (!strcmp(cmd, "help")) { printHelp(); }
  else if (!strcmp(cmd, "show")) { printStatus(); }
  else if (!strcmp(cmd, "layout") && a1) {
    int cols = 0, rows = 0;
    if (sscanf(a1, "%dx%d", &cols, &rows) != 2 || cols < 1 || rows < 1 || cols > MAX_SIDE || rows > MAX_SIDE ||
        cols * rows > MAX_PANELS) {
      Serial.println("Layout: <cols>x<rows>, at most 4 either way and 8 panels");
      return;
    }
    s.cols = cols; s.rows = rows;
    chainPreset(false, false, false);
    settingsSave();
    restartBlank();
  }
  else if (!strcmp(cmd, "chain") && a1 && a2 && strlen(a1) == 2 && (a1[0] == 't' || a1[0] == 'b') &&
           (a1[1] == 'l' || a1[1] == 'r') && (!strcmp(a2, "z") || !strcmp(a2, "s"))) {
    chainPreset(a1[1] == 'r', a1[0] == 'b', a2[0] == 's');
    placementChanged();
  }
  else if (!strcmp(cmd, "panel") && a1 && a2 && a3 && a4) {
    long n = v - 1, c = strtol(a2, nullptr, 10), r = strtol(a3, nullptr, 10), t = strtol(a4, nullptr, 10);
    if (n < 0 || n >= panelCount() || c < 0 || c >= s.cols || r < 0 || r >= s.rows || t < 0 || t > 3) {
      Serial.println("Panel: <n 1..panels> <col> <row> <turn 0..3>");
      return;
    }
    s.panelCol[n] = c; s.panelRow[n] = r; s.panelRot[n] = t;
    placementChanged();
  }
  else if (!strcmp(cmd, "rot") && a1 && v >= 0 && v <= 3) {
    s.rotation = v;
    if (wall) { wall->setRotation(v); }
    placementChanged();
  }
  else if (!strcmp(cmd, "depth") && a1) { setAndRestart(s.depth, v, 2, 8); }
  else if (!strcmp(cmd, "clk") && a1) {
    if (v != 8 && v != 16 && v != 20) { Serial.println("Clock: 8, 16 or 20"); return; }
    setAndRestart(s.clkMHz, v, 8, 20);
  }
  else if (!strcmp(cmd, "rate") && a1) { setAndRestart(s.minRate, v, 30, 255); }
  else if (!strcmp(cmd, "phase") && a1) { setAndRestart(s.clkPhase, v, 0, 1); }
  else if (!strcmp(cmd, "chip") && a1) {
    for (uint8_t i = 0; i < CHIP_COUNT; i++) {
      if (!strcmp(a1, CHIP_NAMES[i])) { setAndRestart(s.chip, i, 0, CHIP_COUNT - 1); return; }
    }
    Serial.println("Chip: shift, fm6124, fm6126a, icn2038s, mbi5124 or dp3246");
  }
  else if (!strcmp(cmd, "double") && a1) { setAndRestart(s.doubleBuf, v, 0, 1); }
  else if (!strcmp(cmd, "blank") && a1) { setAndRestart(s.latBlank, v, 0, 4); }
  else if (!strcmp(cmd, "drive") && a1 && v >= 0 && v <= 3) {
    s.drive = v;
    settingsSave();
    if (panelOk) { setDrive(v); }
    Serial.printf("Drive strength %ld\n", v);
  }
  else if (!strcmp(cmd, "bright") && a1 && v >= 0 && v <= 255) { setBrightness(v); }
  else if (!strcmp(cmd, "screen") && a1 && v >= 1 && v <= SCR_COUNT) { showScreen(v - 1); }
  else if (!strcmp(cmd, "wifi")) { prefs.putBool("wifitest", true); restartBlank(); }
  else if (!strcmp(cmd, "i2c")) { scanI2c(); }
  else if (!strcmp(cmd, "defaults")) { settingsDefaults(); settingsSave(); restartBlank(); }
  else if (!strcmp(cmd, "restart")) { restartBlank(); }
  else { Serial.println("? - 'help' lists the commands"); }
}

void pollConsole() {
  static char line[96];
  static uint8_t len = 0;
  while (Serial.available()) {
    char c = Serial.read();
    if (c == '\r' || c == '\n') {
      if (len) { line[len] = 0; Serial.printf("> %s\n", line); runCommand(line); len = 0; }
    } else if (len < sizeof(line) - 1) {
      line[len++] = c;
    }
  }
}

// --- BOOT button ----------------------------------------------------------------
void pollButton() {
  static bool down = false, held = false;
  static unsigned long downAt = 0;
  bool now = digitalRead(PIN_BOOT) == LOW;
  if (now && !down) { down = true; held = false; downAt = millis(); }
  if (now && down && !held && millis() - downAt >= HOLD_MS) {
    held = true;
    uint8_t next = BRIGHT_STEPS[0];
    for (uint8_t b : BRIGHT_STEPS) { if (b > s.brightness) { next = b; break; } }
    setBrightness(next);
  }
  if (!now && down) {
    down = false;
    if (!held && millis() - downAt >= 30) { showScreen(screen + 1); }
  }
}

// --- Setup and loop -------------------------------------------------------------
void setup() {
  Serial.begin(115200);
  for (int i = 0; i < 30 && !Serial; i++) { delay(100); }   // give the USB console a moment
  pinMode(PIN_BOOT, INPUT_PULLUP);
  Serial.printf("\nWall clock spike. Reset reason: %s\n", resetReasonName(esp_reset_reason()));

  prefs.begin("wcspike");
  settingsLoad();
  uint8_t boots = prefs.getUChar("boots", 0);
  if (boots >= 3) {
    Serial.println("Three starts in a row did not get far: settings back to the defaults");
    settingsDefaults();
    settingsSave();
    boots = 0;
  }
  prefs.putUChar("boots", boots + 1);
  buildCells();
  screen = prefs.getUChar("screen", SCR_CHAIN) % SCR_COUNT;
  for (int v = 0; v < 256; v++) { gifGamma[v] = (uint8_t)lroundf(powf(v / 255.0f, 2.2f) * 255.0f); }

  Wire.begin(PIN_SDA_BOARD, PIN_SCL_BOARD, 100000);
  wireExt.begin(PIN_SDA_EXT, PIN_SCL_EXT, 100000);
  scanI2c();

  bool wifiTest = prefs.getBool("wifitest", false);
  if (wifiTest) { prefs.putBool("wifitest", false); }
  bool joined = wifiTest && wifiJoin();
  Probe before = { 0, 0, 0 };
  if (joined) { Serial.println("WiFi test: probing the router, panel not started yet ..."); before = probeRouter(); }

  panelOk = panelStart();
  if (panelOk) {
    wall = new Wall(s.cols * PANEL, s.rows * PANEL);
    wall->setRotation(s.rotation);
  }
  printStatus();
  Serial.println("'help' lists the commands.");

  if (joined && panelOk) {
    uint8_t shown = screen;
    screen = SCR_RAMPS;                  // a lit panel for the test
    drawScreen(true);
    Probe at[4];
    for (uint8_t d = 0; d < 4; d++) {
      setDrive(d);
      delay(500);
      Serial.printf("WiFi test: probing with the panel running at drive strength %u ...\n", d);
      at[d] = probeRouter();
    }
    setDrive(s.drive);
    Serial.printf("WiFi test, %u TCP connects to %s:%u each (brightness %u, ramps on the panel):\n",
                  PROBE_COUNT, WiFi.gatewayIP().toString().c_str(), PROBE_PORT, s.brightness);
    printProbe("panel not started", before);
    char label[32];
    for (uint8_t d = 0; d < 4; d++) {
      snprintf(label, sizeof(label), "panel on, drive %u", d);
      printProbe(label, at[d]);
    }
    screen = shown;
  }
  if (joined) { wifiOff(); }
  showScreen(screen);
}

void loop() {
  static unsigned long lastSecond = millis();
  static uint32_t lastEdges = frameEdges;
  static bool stable = false;

  pollConsole();
  pollButton();
  drawScreen(false);

  unsigned long now = millis();
  if (now - lastSecond >= 1000) {
    uint32_t edges = frameEdges;
    measuredHz = (edges - lastEdges) * 1000UL / (now - lastSecond);
    lastEdges = edges;
    lastSecond = now;
  }
  if (!stable && now >= STABLE_MS) {
    stable = true;
    prefs.putUChar("boots", 0);
  }
  delay(1);
}
